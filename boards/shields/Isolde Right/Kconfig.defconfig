## boards/shields/Isolde Right/Kconfig.defconfig
```kconfig
# Copyright (c) 2022 The ZMK Contributors
# SPDX-License-Identifier: MIT

if SHIELD_ISOLDE_RIGHT

config ZMK_KEYBOARD_NAME
    default "Isolde_RIGHT"

endif
```

## boards/shields/Isolde Right/Kconfig.shield
```kconfig
# Copyright (c) 2022 The ZMK Contributors
# SPDX-License-Identifier: MIT

config SHIELD_ISOLDE_RIGHT
   def_bool $(shields_list_contains,ISOLDE_RIGHT)
```
