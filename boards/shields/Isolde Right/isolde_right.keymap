/*
 * Copyright (c) 2022 The ZMK Contributors
 *
 * SPDX-License-Identifier: MIT
 */

#include <behaviors.dtsi>
#include <dt-bindings/zmk/keys.h>


// Using layer taps on thumbs, having quick tap as well helps w/ repeating space/backspace
&lt { quick-tap-ms = <200>; };

/ {
    keymap {
        compatible = "zmk,keymap";

        default_layer {
            display-name = "Default Layer";
            bindings = <
            &kp N7          &kp N8  &kp N9          &kp N0  &kp MINUS       &kp EQUAL       &kp BSPC  &trans
            &kp Y           &kp U   &kp I   &kp O           &kp P   &kp LBKT        &kp RBKT        &kp BSLH
            &kp H           &kp I   &kp J   &kp K           &kp L   &kp SEMI        &kp SQT         &kp ENTER
            &kp B           &kp N   &kp M   &kp COMMA       &kp DOT &kp SLASH       &kp UP          &kp RSHFT
            &kp SPACE       &kp LGUI   &trans   &trans           &trans   &kp LEFT        &kp DOWN        &kp RIGHT
        };
        
    };
};
